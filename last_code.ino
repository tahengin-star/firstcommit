// Generated by Modulux Coding IDE
// Board: Modulux ESP32-S3
#include <Arduino.h>
int Degree = 0;
#include <ESP32Servo.h>
Servo myServo;


void setup() {
  Serial.begin(115200);
  { unsigned long _t=millis(); while(!Serial && millis()-_t<3000){delay(10);} }
  delay(150);
  ESP32PWM::allocateTimer(0);
  ESP32PWM::allocateTimer(1);
  ESP32PWM::allocateTimer(2);
  ESP32PWM::allocateTimer(3);
  myServo.setPeriodHertz(50);
  myServo.attach(18, 500, 2400);  // SG90
  delay(200);  // รอให้ servo พร้อม
  myServo.write(90);  // เซ็ตตำแหน่งเริ่มต้น
  delay(500);

    pinMode(35, INPUT_PULLUP);
    pinMode(36, INPUT_PULLUP);
}

void loop() {
    if (digitalRead(35) == 0) {
      Degree += (10);
      if (Degree >= 180) {
        Degree = (180);
      }
      myServo.write(Degree);
      Serial.println("Push1");
    }
    else if (digitalRead(36) == 0) {
      Degree += (-10);
      if (Degree <= 0) {
        Degree = (0);
      }
      myServo.write(Degree);
      Serial.println("Push2");
    }
    delay(50);
}